## meta-my-security/conf/layer.conf
```bitbake
# We have a conf and classes directory, add to BBPATH
BBPATH .= ":${LAYERDIR}"

# We have recipes-* directories, add to BBFILES
BBFILES += "${LAYERDIR}/recipes-*/*/*.bb \
            ${LAYERDIR}/recipes-*/*/*.bbappend"

BBFILE_COLLECTIONS += "meta-my-security"
BBFILE_PATTERN_meta-my-security = "^${LAYERDIR}/"
BBFILE_PRIORITY_meta-my-security = "6"

LAYERDEPENDS_meta-my-security = "core"
LAYERSERIES_COMPAT_meta-my-security = "kirkstone"
```
